## board/chromebook/kukui/kernel.its
```
/dts-v1/;

/ {
	description = "Buildroot kernel for Chromebook Kukui";
	#address-cells = <1>;

	images {
		kernel-1 {
			data = /incbin/("Image");
			type = "kernel_noload";
			arch = "arm64";
			os = "linux";
			compression = "none";
			load = <0>;
			entry = <0>;
		};
		fdt-1 {
			description = "kukui.dtb";
			data = /incbin/("mt8183-kukui-krane-sku176.dtb");
			type = "flat_dt";
			arch = "arm64";
			compression = "none";

			hash-1 {
				algo = "sha1";
			};
		};
	};

	configurations {
		default = "conf-1";
		conf-1 {
			kernel = "kernel-1";
			fdt = "fdt-1";
		};
	};
};
```

## configs/chromebook_kukui_defconfig
```kconfig
BR2_aarch64=y
BR2_cortex_a73_a53=y
BR2_KERNEL_HEADERS_5_15=y
BR2_ROOTFS_POST_BUILD_SCRIPT="board/chromebook/kukui/sign.sh"
BR2_ROOTFS_POST_IMAGE_SCRIPT="board/chromebook/mksd.sh"
BR2_LINUX_KERNEL=y
BR2_LINUX_KERNEL_CUSTOM_TARBALL=y
BR2_LINUX_KERNEL_CUSTOM_TARBALL_LOCATION="https://git.kernel.org/torvalds/t/linux-5.17-rc7.tar.gz"
BR2_LINUX_KERNEL_PATCH="board/chromebook/kukui/kukui.add-it6505.patch board/chromebook/kukui/kukui.cci-1.patch board/chromebook/kukui/kukui.cci-2.patch board/chromebook/kukui/kukui.cci-3.patch board/chromebook/kukui/kukui.cci-4.patch board/chromebook/kukui/kukui.cci-5.patch board/chromebook/kukui/kukui.cci-6.patch board/chromebook/kukui/kukui.cci-7.patch board/chromebook/kukui/kukui.cci-8.patch board/chromebook/kukui/kukui.enable-ite.patch board/chromebook/kukui/kukui.gpu.patch board/chromebook/kukui/kukui.gpu-vsram.patch board/chromebook/kukui/kukui.move-gpu-opp-to-3.patch board/chromebook/kukui/kukui.opp-multi-regulator.patch board/chromebook/kukui/kukui.panel-dts-rotation.patch board/chromebook/kukui/kukui.panel-dts-rotation_sku0.patch"
BR2_LINUX_KERNEL_USE_CUSTOM_CONFIG=y
BR2_LINUX_KERNEL_CUSTOM_CONFIG_FILE="board/chromebook/kukui/linux.config"
BR2_LINUX_KERNEL_DTS_SUPPORT=y
BR2_LINUX_KERNEL_INTREE_DTS_NAME="mediatek/mt8183-kukui-krane-sku176"
BR2_PACKAGE_LINUX_FIRMWARE=y
BR2_TARGET_ROOTFS_EXT2=y
BR2_TARGET_ROOTFS_EXT2_4=y
BR2_PACKAGE_HOST_PARTED=y
BR2_PACKAGE_HOST_UBOOT_TOOLS=y
BR2_PACKAGE_HOST_UBOOT_TOOLS_FIT_SUPPORT=y
BR2_PACKAGE_HOST_VBOOT_UTILS=y
```

## configs/chromebook_veyron_minnie_defconfig
```kconfig
BR2_arm=y
BR2_cortex_a17=y
BR2_ARM_FPU_VFPV4=y
BR2_KERNEL_HEADERS_4_9=y
BR2_TARGET_GENERIC_GETTY_PORT="tty1"
BR2_TARGET_GENERIC_GETTY_TERM="linux"
BR2_ROOTFS_POST_BUILD_SCRIPT="board/chromebook/veyron/sign.sh"
BR2_ROOTFS_POST_IMAGE_SCRIPT="board/chromebook/mksd.sh"
BR2_LINUX_KERNEL=y
BR2_LINUX_KERNEL_CUSTOM_VERSION=y
BR2_LINUX_KERNEL_CUSTOM_VERSION_VALUE="5.9.8"
BR2_LINUX_KERNEL_PATCH="\
    board/chromebook/veyron/0001-block-partitions-efi-Add-support-for-IGNOREME-GPT-si.patch \
    board/chromebook/veyron/0014-usb-dwc2-gadget-Add-handler-for-WkupAlert-interrupt.patch board/chromebook/veyron/0001-Fix-ath9k-dwc2-init-frame-overruns.patch \
    board/chromebook/veyron/0100-arm-errata-workaround-errata-A12-857271-and-A17-857272.patch board/chromebook/veyron/0002-Do-not-force-GUID-partition-with-gpt-command-line-op.patch \
    board/chromebook/veyron/Added-a-second-reset-when-having-an-issue-reading-th.patch \
    board/chromebook/veyron/0007-RK3288-DTSI-rk3288-Add-missing-SPI2-pinctrl.patch \
    board/chromebook/veyron/Don-t-try-to-flush-cache-on-reset.patch \
    board/chromebook/veyron/0008-usb-dwc2-Add-dwc2_gadget_dec_frame_num_by_one-functi.patch \
    board/chromebook/veyron/silence_vop_spam.patch \
    "
BR2_LINUX_KERNEL_USE_CUSTOM_CONFIG=y
BR2_LINUX_KERNEL_CUSTOM_CONFIG_FILE="board/chromebook/veyron/linux-5.9.8-config"
BR2_LINUX_KERNEL_DTS_SUPPORT=y
BR2_LINUX_KERNEL_INTREE_DTS_NAME="rk3288-veyron-minnie"
BR2_PACKAGE_LINUX_FIRMWARE=y
BR2_TARGET_ROOTFS_EXT2=y
BR2_TARGET_ROOTFS_EXT2_4=y
BR2_PACKAGE_HOST_PARTED=y
BR2_PACKAGE_HOST_UBOOT_TOOLS=y
BR2_PACKAGE_HOST_UBOOT_TOOLS_FIT_SUPPORT=y
BR2_PACKAGE_HOST_VBOOT_UTILS=y
```

## configs/licheepi_nano_defconfig
```kconfig
# ARMv5 compilation target (Allwinner F1C100s)
BR2_arm=y
BR2_ARCH="arm"
BR2_ENDIAN="LITTLE"
BR2_GCC_TARGET_ABI="aapcs-linux"
BR2_GCC_TARGET_CPU="arm926ej-s"
BR2_GCC_TARGET_FLOAT_ABI="soft"
BR2_GCC_TARGET_MODE="arm"
BR2_ARM_CPU_MAYBE_HAS_FPU=y
BR2_ARM_CPU_MAYBE_HAS_VFPV2=y
BR2_ARM_CPU_HAS_ARM=y
BR2_ARM_CPU_HAS_THUMB=y
BR2_ARM_CPU_ARMV5=y
BR2_arm926t=y

# Internal Buildroot toolchain, with headers matching custom kernel
BR2_PACKAGE_HOST_LINUX_HEADERS_CUSTOM_5_4=y

# OS name and login settings
BR2_TARGET_GENERIC_HOSTNAME="licheepi-nano"
BR2_TARGET_GENERIC_ISSUE="Welcome to LicheePi Nano"

# TTY
BR2_TARGET_GENERIC_GETTY_PORT="/dev/ttyS0"
BR2_TARGET_GENERIC_GETTY_BAUDRATE_115200=y

# Linux kernel customized for the board
BR2_LINUX_KERNEL=y
BR2_LINUX_KERNEL_CUSTOM_GIT=y
# @unframework Linux fork and tag
# (cherry-picked from Lichee-Pi Linux fork nano-5.2-flash branch as of 2021-03-06)
BR2_LINUX_KERNEL_CUSTOM_REPO_URL="https://github.com/unframework/linux"
BR2_LINUX_KERNEL_CUSTOM_REPO_VERSION="v5.11-nano-3"
BR2_LINUX_KERNEL_USE_CUSTOM_CONFIG=y
BR2_LINUX_KERNEL_CUSTOM_CONFIG_FILE="board/sipeed/lichee-nano/licheepi_nano_linux_defconfig"
# custom DTS file with local overrides
BR2_LINUX_KERNEL_DTS_SUPPORT=y
BR2_LINUX_KERNEL_CUSTOM_DTS_PATH="board/sipeed/lichee-nano/suniv-f1c100s-licheepi-nano.dts"

#
# Build root FS ext2 (for TF card)
#
BR2_TARGET_ROOTFS_EXT2=y
BR2_TARGET_ROOTFS_EXT2_4=y
BR2_TARGET_ROOTFS_EXT2_SIZE="100M"

#
# Package up the images for deployment to board
#
BR2_ROOTFS_POST_IMAGE_SCRIPT="board/sipeed/lichee-nano/post-image.sh"

#
# U-Boot customized for the board
#
BR2_TARGET_UBOOT=y
BR2_TARGET_UBOOT_BOARDNAME="licheepi_nano"
BR2_TARGET_UBOOT_CUSTOM_GIT=y
# @unframework U-Boot fork and tag
# (rebased from @Icenowy U-Boot fork f1c100s-spiflash branch as of 2021-03-06, plus others)
BR2_TARGET_UBOOT_CUSTOM_REPO_URL="https://github.com/unframework/u-boot"
BR2_TARGET_UBOOT_CUSTOM_REPO_VERSION="v2021.01-f1c100s-4"
BR2_TARGET_UBOOT_NEEDS_DTC=y
BR2_TARGET_UBOOT_NEEDS_PYLIBFDT=y
BR2_TARGET_UBOOT_FORMAT_CUSTOM=y
BR2_TARGET_UBOOT_FORMAT_CUSTOM_NAME="u-boot-sunxi-with-spl.bin"
BR2_TARGET_UBOOT_BOOT_SCRIPT=y
BR2_TARGET_UBOOT_BOOT_SCRIPT_SOURCE="board/sipeed/lichee-nano/boot.cmd"

#
# Extra host dependencies to build images
#
BR2_PACKAGE_HOST_GENIMAGE=y
BR2_PACKAGE_HOST_MTOOLS=y

# original Lichee-Pi Linux fork and branch without Flash-specific config changes
# BR2_LINUX_KERNEL_CUSTOM_REPO_URL="https://github.com/Lichee-Pi/linux"
# BR2_LINUX_KERNEL_CUSTOM_REPO_VERSION="nano-5.2-tf"
# original Lichee-Pi Linux fork provided defconfig
# BR2_LINUX_KERNEL_DEFCONFIG="licheepi_nano"

# original Lichee-Pi U-Boot fork and branch
# BR2_TARGET_UBOOT_CUSTOM_REPO_URL="https://github.com/Lichee-Pi/u-boot"
# BR2_TARGET_UBOOT_CUSTOM_REPO_VERSION="nano-v2018.01"
```

## configs/miyoo_bittboy_defconfig
```kconfig
# Toolchain
BR2_arm=y
BR2_arm926t=y
BR2_KERNEL_HEADERS_4_14=y

# Linux kernel
BR2_LINUX_KERNEL=y
BR2_LINUX_KERNEL_CUSTOM_GIT=y
BR2_LINUX_KERNEL_CUSTOM_REPO_URL="https://github.com/MiyooCFW/kernel"
BR2_LINUX_KERNEL_CUSTOM_REPO_VERSION="90d913918f42b96b4cd09b50c5120e724e34f8c9"
BR2_LINUX_KERNEL_USE_CUSTOM_CONFIG=y
BR2_LINUX_KERNEL_CUSTOM_CONFIG_FILE="board/miyoo/bittboy/miyoo_bittboy_linux_defconfig"
BR2_LINUX_KERNEL_DTS_SUPPORT=y
BR2_LINUX_KERNEL_CUSTOM_DTS_PATH="board/miyoo/bittboy/devicetree/linux/suniv-f1c500s-miyoo.dts"

# Build root FS ext2 (for TF card)
BR2_TARGET_ROOTFS_EXT2=y
BR2_TARGET_ROOTFS_EXT2_4=y
BR2_TARGET_ROOTFS_EXT2_SIZE="100M"
BR2_ROOTFS_POST_IMAGE_SCRIPT="board/miyoo/bittboy/post-image.sh"

# U-Boot
BR2_TARGET_UBOOT=y
BR2_TARGET_UBOOT_BUILD_SYSTEM_KCONFIG=y
BR2_TARGET_UBOOT_CUSTOM_VERSION=y
BR2_TARGET_UBOOT_CUSTOM_VERSION_VALUE="2020.07"
BR2_TARGET_UBOOT_NEEDS_DTC=y
BR2_TARGET_UBOOT_FORMAT_BIN=y
BR2_TARGET_UBOOT_SPL=y
BR2_TARGET_UBOOT_USE_CUSTOM_CONFIG=y
BR2_TARGET_UBOOT_SPL_NAME="u-boot-sunxi-with-spl.bin"
BR2_TARGET_UBOOT_PATCH="board/miyoo/bittboy/patch/u-boot"
BR2_TARGET_UBOOT_CUSTOM_CONFIG_FILE="board/miyoo/bittboy/miyoo_bittboy_uboot_defconfig"
BR2_TARGET_UBOOT_CUSTOM_DTS_PATH="board/miyoo/bittboy/devicetree/uboot/suniv-f1c100s.dtsi board/miyoo/bittboy/devicetree/uboot/suniv-f1c100s-generic.dts"
BR2_TARGET_UBOOT_BOOT_SCRIPT_SOURCE="board/miyoo/bittboy/boot.cmd"

# Extra host dependencies to build images
BR2_PACKAGE_HOST_DOSFSTOOLS=y
BR2_PACKAGE_HOST_GENIMAGE=y
BR2_PACKAGE_HOST_MTOOLS=y

# Game Libraries
BR2_PACKAGE_ALSA_UTILS=y
BR2_PACKAGE_FFMPEG=y
BR2_PACKAGE_FLUIDLITE=y
BR2_PACKAGE_MPG123=y
BR2_PACKAGE_BZIP2=y
BR2_PACKAGE_SDL=y
BR2_PACKAGE_SDL_FBCON=y
BR2_PACKAGE_SDL_GFX=y
BR2_PACKAGE_SDL_IMAGE=y
BR2_PACKAGE_SDL_IMAGE_GIF=y
BR2_PACKAGE_SDL_IMAGE_JPEG=y
BR2_PACKAGE_SDL_IMAGE_PCX=y
BR2_PACKAGE_SDL_IMAGE_PNG=y
BR2_PACKAGE_SDL_MIXER=y
BR2_PACKAGE_SDL_NET=y
BR2_PACKAGE_SDL_SOUND=y
BR2_PACKAGE_SDL_TTF=y
BR2_PACKAGE_LIBMIKMOD=y
BR2_PACKAGE_LIBSAMPLERATE=y
BR2_PACKAGE_LIBSNDFILE=y
BR2_PACKAGE_LIBVORBIS=y
BR2_PACKAGE_OPENAL=y
BR2_PACKAGE_PORTAUDIO=y
BR2_PACKAGE_TREMOR=y
BR2_PACKAGE_AGG=y
BR2_PACKAGE_PIXMAN=y
BR2_PACKAGE_EXPAT=y
BR2_PACKAGE_FMT=y
```

## configs/swift_x86_64_defconfig
```kconfig
BR2_x86_64=y

BR2_TOOLCHAIN_BUILDROOT_VENDOR="swift"
BR2_TOOLCHAIN_BUILDROOT_GLIBC=y
BR2_KERNEL_HEADERS_4_9=y
BR2_TOOLCHAIN_BUILDROOT_CXX=y
BR2_TARGET_GENERIC_HOSTNAME="swift-linux"
BR2_TARGET_GENERIC_ISSUE="Welcome to Swift Linux"
BR2_GENERATE_LOCALE="en_US"
BR2_PACKAGE_CA_CERTIFICATES=y
BR2_PACKAGE_OPENSSL=y
BR2_PACKAGE_LIBXML2=y
BR2_PACKAGE_LIBCURL=y
BR2_PACKAGE_LIBBSD=y
BR2_PACKAGE_LIBDISPATCH=y
BR2_PACKAGE_ICU=y
```

## package/foundation/Config.in
```kconfig
if BR2_PACKAGE_SWIFT

config BR2_PACKAGE_FOUNDATION
	bool "foundation"
	depends on BR2_PACKAGE_SWIFT
	depends on BR2_PACKAGE_LIBDISPATCH
	help
	  The Foundation framework defines a base layer of functionality that is required for almost all applications. It provides primitive classes and introduces several paradigms that define functionality not provided by either the Objective-C runtime and language or Swift standard library and language.

	  http://swift.org

if BR2_PACKAGE_FOUNDATION

comment "FoundationXML needs libxml2"
	depends on BR2_PACKAGE_FOUNDATION
	depends on !BR2_PACKAGE_LIBXML2

comment "FoundationNetworking needs libcurl"
	depends on BR2_PACKAGE_FOUNDATION
	depends on !BR2_PACKAGE_LIBCURL

endif

endif
```

## package/libswiftdispatch/Config.in
```kconfig
config BR2_PACKAGE_LIBSWIFTDISPATCH
	bool "libswiftdispatch"
	depends on BR2_TOOLCHAIN_HAS_THREADS
	depends on !BR2_STATIC_LIBS
	depends on BR2_TOOLCHAIN_USES_GLIBC
	depends on BR2_PACKAGE_LIBBSD
	depends on BR2_PACKAGE_SWIFT
	
	help
	  Grand Central Dispatch (GCD or libdispatch) provides comprehensive support for concurrent code execution on multicore hardware.

	  http://swift.org
```

## package/swift-bluetooth-linux/Config.in
```kconfig
if BR2_PACKAGE_SWIFT

config BR2_PACKAGE_SWIFT_BLUETOOTH_LINUX
	bool "swift-bluetooth-linux"
	depends on BR2_PACKAGE_SWIFT
	depends on BR2_PACKAGE_FOUNDATION
	depends on BR2_PACKAGE_SWIFT_BLUETOOTH
	depends on BR2_PACKAGE_SWIFT_SYSTEM
	depends on BR2_PACKAGE_SWIFT_SOCKET
	help
	  Pure Swift Bluetooth Stack for Linux. Does not require BlueZ userland library, communicates directly with the Linux kernel Bluetooth subsystem.
	  
endif
```

## package/swift-bluetooth/Config.in
```kconfig
if BR2_PACKAGE_SWIFT

config BR2_PACKAGE_SWIFT_BLUETOOTH
	bool "swift-bluetooth"
	depends on BR2_PACKAGE_SWIFT
	depends on BR2_PACKAGE_FOUNDATION
	help
	  Pure Swift Bluetooth Definitions.
	  
endif
```

## package/swift-crypto/Config.in
```kconfig
if BR2_PACKAGE_SWIFT

config BR2_PACKAGE_SWIFT_CRYPTO
	bool "swift-crypto"
	select BR2_PACKAGE_SWIFT
	select BR2_PACKAGE_FOUNDATION
	help
	  Swift Crypto is an open-source implementation of a substantial portion of the API of Apple CryptoKit suitable for use on Linux platforms.
	  
endif
```

## package/swift-gatt/Config.in
```kconfig
if BR2_PACKAGE_SWIFT

config BR2_PACKAGE_SWIFT_GATT
	bool "swift-bluetooth"
	depends on BR2_PACKAGE_SWIFT
	depends on BR2_PACKAGE_FOUNDATION
	depends on BR2_PACKAGE_SWIFT_BLUETOOTH
	help
	  Bluetooth Generic Attribute Profile (GATT) for Swift.
	  
endif
```

## package/swift-hello/Config.in
```kconfig
if BR2_PACKAGE_SWIFT

config BR2_PACKAGE_SWIFT_HELLO
	bool "swift-hello"
	select BR2_PACKAGE_SWIFT
	select BR2_PACKAGE_FOUNDATION
	help
	  Demo application for Swift.
	  
endif
```

## package/swift-netlink/Config.in
```kconfig
if BR2_PACKAGE_SWIFT

config BR2_PACKAGE_SWIFT_NETLINK
	bool "swift-netlink"
	depends on BR2_PACKAGE_SWIFT
	depends on BR2_PACKAGE_FOUNDATION
	depends on BR2_PACKAGE_SWIFT_SOCKET
	help
	  Swift library for communicating with Linux Kernel Netlink subsystem.
	  
endif
```

## package/swift-socket/Config.in
```kconfig
if BR2_PACKAGE_SWIFT

config BR2_PACKAGE_SWIFT_SOCKET
	bool "swift-socket"
	depends on BR2_PACKAGE_SWIFT
	depends on BR2_PACKAGE_FOUNDATION
	depends on BR2_PACKAGE_SWIFT_SYSTEM
	help
	  Socket provides idiomatic Swift interfaces to POSIX sockets.
	  
endif
```

## package/swift-system/Config.in
```kconfig
if BR2_PACKAGE_SWIFT

config BR2_PACKAGE_SWIFT_SYSTEM
	bool "swift-system"
	depends on BR2_PACKAGE_SWIFT
	help
	  Swift System provides idiomatic interfaces to system calls and low-level currency types.
	  
endif
```

## package/swift-wlan/Config.in
```kconfig
if BR2_PACKAGE_SWIFT

config BR2_PACKAGE_SWIFT_WLAN
	bool "swift-wlan"
	depends on BR2_PACKAGE_SWIFT
	depends on BR2_PACKAGE_FOUNDATION
	help
	  Swift library for interacting with WiFi hardware and scanning for wireless networks.
	  
endif
```

## package/swift/Config.in
```kconfig
config BR2_PACKAGE_SWIFT_ARCH_SUPPORTS
	bool
	default y if BR2_x86_64
	default y if BR2_aarch64
	default y if BR2_arm

config BR2_PACKAGE_SWIFT_TARGET_ARCH
	string
	default "aarch64" if BR2_aarch64
	default "armv7" if BR2_arm
	default "x86_64" if BR2_x86_64

config BR2_PACKAGE_SWIFT
	bool "swift"
	depends on BR2_PACKAGE_SWIFT_ARCH_SUPPORTS
	depends on BR2_PACKAGE_ICU
	depends on BR2_TOOLCHAIN_HAS_THREADS
	depends on !BR2_STATIC_LIBS
	depends on BR2_TOOLCHAIN_USES_GLIBC
	depends on BR2_PACKAGE_ICU
	help
	  Swift is a general-purpose programming language built using a modern approach to safety, performance, and software design patterns.

	  http://swift.org

if BR2_PACKAGE_SWIFT

config BR2_PACKAGE_SWIFT_VERSION
	string "Swift version"
	default "5.4.2"

config BR2_PACKAGE_SWIFT_NATIVE_TOOLS
	string "Path to host Swift toolchain"
	default "/usr"

config BR2_PACKAGE_SWIFT_LLVM_DIR
	string "Path to host LLVM library path"
	default "/usr/lib/llvm-12"

endif

comment "swift needs a toolchain w/ Glibc, ICU, wchar, threads, C++, dynamic library"
	depends on BR2_PACKAGE_SWIFT_ARCH_SUPPORTS
	depends on !BR2_TOOLCHAIN_USES_GLIBC || !BR2_TOOLCHAIN_HAS_THREADS || !BR2_INSTALL_LIBSTDCPP \
		|| BR2_STATIC_LIBS || !BR2_USE_WCHAR || !BR2_PACKAGE_ICU
```
